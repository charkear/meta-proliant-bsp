## conf/layer.conf
```bitbake
# We have a conf and classes directory, add to BBPATH
BBPATH .= ":${LAYERDIR}"

# We have recipes-* directories, add to BBFILES
BBFILES += "${LAYERDIR}/recipes-*/*/*.bb \
            ${LAYERDIR}/recipes-*/*/*.bbappend"

BBFILE_COLLECTIONS += "proliantbsp"
BBFILE_PATTERN_proliantbsp = "^${LAYERDIR}/"
BBFILE_PRIORITY_proliantbsp = "5"
LAYERVERSION_proliantbsp = "4"
LAYERSERIES_COMPAT_proliantbsp = "nanbield"
```

## conf/machine/proliant-yocto.conf
```bitbake
#@TYPE: Machine
#@NAME: ProLiant-yocto machine
#@DESCRIPTION: Reference machine configuration.

MACHINE_EXTRA_RRECOMMENDS = "kernel-modules kernel-devicetree"

EXTRA_IMAGEDEPENDS += "virtual/bootloader"

include conf/machine/include/arm/armv7a/tune-cortexa9.inc

SERIAL_CONSOLES ?= "115200;ttyS0"

PREFERRED_PROVIDER_virtual/kernel ?= "linux-gxp"
# PREFERRED_VERSION_linux-gxp ?= "6.5%"
# KERNEL_DEVICETREE = "hpe/hpe-bmc-dl360gen10.dtb"
PREFERRED_VERSION_linux-gxp ?= "6.1%"
KERNEL_DEVICETREE = "gxp.dtb"

# KERNEL_CLASSES = "kernel-fitimage"
# FIT_HASH_ALG = "sha512"
# KERNEL_IMAGETYPE = "fitImage"
KERNEL_IMAGETYPE = "zImage"
INITRAMFS_IMAGE = "proliant-image-initramfs"
# KERNEL_IMAGE_MAXSIZE = "1024"
# #28160 - KERNEL_IMAGE_MAXSIZE in kb 
# INITRAMFS_MAXSIZE = "25088"

PREFERRED_PROVIDER_virtual/bootloader ?= "u-boot-gxp"
PREFERRED_VERSION_u-boot-gxp ?= "2023.10%"
UBOOT_MACHINE = "gxp2_defconfig"
# UBOOT_LOADADDRESS ?= "${UBOOT_ENTRYPOINT}"
UBOOT_ENTRYPOINT = "0x40008000"
```

## recipes-bsp/image/gxp2-fitimage/fitimage.its
```
/dts-v1/;

/ {
        description = "U-Boot fitImage for gxp2 ASIC";
        #address-cells = <1>;

        images {
                kernel {
                        description = "Linux kernel";
                        data = /incbin/("zImage");
                        type = "kernel";
                        arch = "arm";
                        os = "linux";
                        compression = "none";
                        load = <0x40008000>;
                        entry = <0x40008000>;
                        hash {
                                algo = "sha512";
                        };
                };
                fdt_gxp {
                        description = "Flattened Device Tree blob";
                        data = /incbin/("gxp.dtb");
                        type = "flat_dt";
                        arch = "arm";
                        compression = "none";
                        hash {
                                algo = "sha512";
                        };
                };
                ramdisk {
                        description = "initramfs";
                        data = /incbin/("proliant-image-proliant-yocto.cpio.gz");
                        type = "ramdisk";
                        arch = "arm";
                        os = "linux";
                        compression = "none";
                        hash {
                                algo = "sha512";
                        };
                };

        };

        configurations {
                default = "conf";
                conf {
                        description = "Linux kernel, FDT blob";
                        kernel = "kernel";
                        fdt = "fdt_gxp";
                        ramdisk = "ramdisk";
                        hash {
                                algo = "sha512";
                        };
                };
        };
};
```
